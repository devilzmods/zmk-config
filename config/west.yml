## config/west.yml
```yaml
manifest:
  defaults:
    revision: v0.3
  remotes:
    - name: zmkfirmware
      url-base: https://github.com/zmkfirmware
    - name: trex_shield_module
      url-base: https://github.com/devilzmods/
    - name: zmk-locales
      url-base: https://github.com/joelspadin/
    - name: pain27_shield_module
      url-base: https://github.com/devilzmods/
    # Additional modules containing boards/shields/custom code can be listed here as well
    # See https://docs.zephyrproject.org/3.2.0/develop/west/manifest.html#projects
  projects:
    - name: zmk
      remote: zmkfirmware
      import: app/west.yml
    - name: trex_shield_module
      remote: trex_shield_module
      revision: main
    - name: zmk-locales
      remote: zmk-locales
      revision: main
    - name: pain27_shield_module
      remote: pain27_shield_module
      revision: main
  self:
    path: config
```
